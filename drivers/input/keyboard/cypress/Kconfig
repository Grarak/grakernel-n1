## drivers/input/keyboard/cypress/Kconfig
```kconfig
#
# Cypress touchkey configuration
#

config KEYBOARD_CYPRESS_TOUCH
    tristate "CYPRESS Touchkey"
    depends on I2C
    help
      Say Y here if you have the CYPRESS touchkey controller
      chip in your system.

      If unsure, say N.

      To compile this driver as a module, choose M here: the
      module will be called mcs_touchkey.

config TOUCHKEY_BLN_CYPRESS
	bool "BLN Support for Cypress touchkeys."
	depends on KEYBOARD_CYPRESS_TOUCH
	help
	  BLN support.
```

## drivers/sensors/Kconfig
```kconfig
menuconfig SENSORS
	bool "Sensors Support"
	help
	  Say Y to enable Sensors support.  This allows control of supported
	  Sensors.

if SENSORS

config SENSORS_KXTF9	
	tristate "KXTF9"
	default n
	depends on I2C
	help
	  KXTF9 raw module, if the MPU hal is not used.

source "drivers/sensors/proxlight/Kconfig"
source "drivers/sensors/compass/Kconfig"
source "drivers/sensors/mpu3050_v333/Kconfig"

endif # SENSORS
```
